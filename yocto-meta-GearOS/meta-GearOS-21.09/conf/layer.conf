## yocto-meta-GearOS/meta-GearOS-21.09/conf/layer.conf
```bitbake
# We have a conf and classes directory, add to BBPATH
BBPATH .= ":${LAYERDIR}"

# We have recipes-* directories, add to BBFILES
BBFILES += "${LAYERDIR}/recipes-*/*/*.bb \
            ${LAYERDIR}/recipes-*/*/*.bbappend"

BBFILE_COLLECTIONS += "meta-GearOS-21.09"
BBFILE_PATTERN_meta-GearOS-21.09 = "^${LAYERDIR}/"
BBFILE_PRIORITY_meta-GearOS-21.09 = "10"

LAYERDEPENDS_meta-GearOS-21.09 = "core"
LAYERSERIES_COMPAT_meta-GearOS-21.09 = "hardknott"
```
